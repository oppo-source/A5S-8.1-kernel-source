## drivers/input/fingerprint/Kconfig
```kconfig
#
#Fingerprint
#
menu "Fingerprint support"
	depends on INPUT

config MTK_FINGERPRINT_SUPPORT
	bool "Mediatek Fingerprint"
	default n
	help
	  Fingerprint mtk driver enable/disable in the kernel.
	  Say Y here if you want to use mediatek fingerprint driver,
	  fingerprint driver will support fingerprint function

if MTK_FINGERPRINT_SUPPORT
config MTK_FINGERPRINT_SELECT
	string "sensor type"
#	default "GF318M"
        default "MULTI"

# Silead Fingerprint driver configuration

config SILEAD_FP
	tristate "Silead Fingerprint driver support"
	help
	  This supports Silead Fingerprint drivers.

config SILEAD_FP_SPI
	tristate "Silead spi Fingerprint driver support"
	select SILEAD_FP
	help
	  This supports Silead spi Fingerprint drivers.

config SILEAD_FP_PLATFORM
	tristate "Silead platformm Fingerprint driver support"
	select SILEAD_FP
	help
	  This supports Silead platform Fingerprint drivers.

config EGIS_FP
	tristate "Egis Fingerprint driver support"
	help
	  This supports Egis Fingerprint drivers.

config EGIS_FP_PLATFORM
	tristate "Egis platformm Fingerprint driver support"
	select EGIS_FP
	help
	  This supports Egis platform Fingerprint drivers.

if MTK_FINGERPRINT_SELECT = "FPC1145"
config FPC_FINGERPRINT
	bool "FPC Fingerprint"
	default y
	help
	  FPC fingerprint FPC's 102x/104x device.
endif

if MTK_FINGERPRINT_SELECT = "GF318M" ||  MTK_FINGERPRINT_SELECT = "GF5216"
config GOODIX_FINGERPRINT
	bool "Goodix Fingerprint"
	default y
	help
	  Goodix Fingerprint chip GF316M/GF318M/GF3118M/GF518M/GF5118M/GF516M/GF816M/GF3208/GF3206/
	  GF3266/GF3288/GF5206/GF5216/GF5208 TEE driver

config GOODIX_SENSOR_TYPE
	string "SENSOR_TYPE"
	default "GF5216"
	help
	  Must input sensor type, or default is GF316M GF318M GF3118M GF518M GF5118M GF516M GF816M
	  GF3208 GF3206 GF3266 GF3288 GF5206 GF5216 GF5208
endif
endif
endmenu
```

## drivers/input/touchscreen/mediatek/ft8006p/Kconfig
```kconfig
#
# Touchscreen driver configuration
#
config TOUCHSCREEN_FT8006P
    bool "Focaltech Ts for Mediatek"
    depends on SPI_MASTER
    default n
    help
      Say Y here if you have Focaltech touch panel.
      If unsure, say N.

config TOUCHSCREEN_MTK_FTS_DIRECTORY
    string "Focaltech ts directory name"
    default "ft8006p"
    depends on TOUCHSCREEN_FT8006P
    
```

## drivers/input/touchscreen/mediatek/himax_summer/Kconfig
```kconfig
#
# Himax Touchscreen driver configuration
#
config TOUCHSCREEN_HIMAX_CHIPSET
        tristate "HIMAX chipset touchscreen"
		help
		This enables support for HIMAX CHIPSET over I2C based touchscreens.

config TOUCHSCREEN_HIMAX_COMMON
        tristate "HIMAX chipset spi touchscreen"
		depends on TOUCHSCREEN_HIMAX_CHIPSET
		help
		This enables support for HIMAX CHIPSET over I2C based touchscreens.
		
config TOUCHSCREEN_HIMAX_INCELL
        tristate "HIMAX chipset in-cell function"
		depends on TOUCHSCREEN_HIMAX_COMMON
		help
		This enables support for HIMAX CHIPSET of in-cell function.

config TOUCHSCREEN_HIMAX_IC_HX83112
        tristate "HIMAX chipset HX83112 function"
		depends on TOUCHSCREEN_HIMAX_INCELL
		help
		This enables support for HIMAX CHIPSET of HX83112.

config TOUCHSCREEN_HIMAX_DEBUG
        tristate "HIMAX debug function"
		depends on TOUCHSCREEN_HIMAX_COMMON
		help
		This enables support for HIMAX debug function.
config TOUCHSCREEN_HIMAX_INSPECT
        tristate "HIMAX inspect function"
		depends on TOUCHSCREEN_HIMAX_COMMON
		help
		This enables support for HIMAX debug function.
config HMX_DB
	tristate "HIMAX driver test over Dragon Board"
	depends on TOUCHSCREEN_HIMAX_COMMON
	help
	  This enables support for HIMAX driver test over Dragon Board.
```

## drivers/input/touchscreen/mediatek/ipio_touch_mmi/Kconfig
```kconfig
#*******************************************************************************
# Copyright (C), 2008-2018, OPPO Mobile Comm Corp., Ltd.
# ODM_WT_EDIT
# FILE: - Kconfig
# Description : This program is for ili9881 driver configuration
# Version: 1.0
# Date : 2018/5/17
# Author: Zhonghua.Hu@ODM_WT.BSP.TP-FP.TP
#
# -------------------------Revision History:----------------------------------
#  <author>	 <data> 	<version >			<desc>
#
#
#*****************************************************************************/
config TOUCHSCREEN_ILI9881H
	bool "li9881 touchpanel driver"
	default y
	help
	  Say Y here if you have a Novatek NT36xxx no flash touchscreen connected
	  to your system by SPI bus.

	  If unsure, say N.
```

## drivers/misc/mediatek/power/Kconfig
```kconfig
# Power Related
config MTK_PMIC
	bool "MediaTek PMIC driver"
	---help---
	  MediaTek PMIC driver

config MTK_SM5414_SUPPORT
	bool "Charger Driver for SM SM5414 Charger IC"
	help
	  SM SM5414 driver.
```

## drivers/soc/oppo/Kconfig
```kconfig
#ifdef VENDOR_EDIT
# Bin.Li@EXP.BSP.bootloader.bootflow, 2017/05/15, Add for config oppo software common soft
config OPPO_ARCH_FILE
    bool "for build directory oppo"
    ---help---
    say Y to buid in

config OPPO_COMMON_SOFT
        bool "config oppo common software"
        select OPPO_ARCH_FILE
        help
        define this config to get project verion from sharemem.
        Maybe this value is from CDT or dynamic identify by hardware
        id.




#endif /* VENDOR_EDIT */
```
